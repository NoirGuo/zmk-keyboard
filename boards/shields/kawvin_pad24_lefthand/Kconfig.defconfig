## boards/shields/kawvin_pad24_lefthand/Kconfig.defconfig
```kconfig
# Copyright (c) 2021 The ZMK Contributors
# SPDX-License-Identifier: MIT

if SHIELD_KAWVIN_PAD24_LEFTHAND

config ZMK_KEYBOARD_NAME
    default "Kawvin_Pad24"

#config ZMK_RGB_UNDERGLOW
#    select WS2812_STRIP
#    select SPI

endif
```

## boards/shields/kawvin_pad24_lefthand/Kconfig.shield
```kconfig
# Copyright (c) 2021 The ZMK Contributors
# SPDX-License-Identifier: MIT

config SHIELD_KAWVIN_PAD24_LEFTHAND
    def_bool $(shields_list_contains,kawvin_pad24_lefthand)
```

## boards/shields/kawvin_pad24_righthand/Kconfig.shield
```kconfig
# Copyright (c) 2021 The ZMK Contributors
# SPDX-License-Identifier: MIT

config SHIELD_KAWVIN_PAD24_RIGHTHAND
    def_bool $(shields_list_contains,kawvin_pad24_righthand)
```

## boards/shields/ky89/Kconfig.defconfig
```kconfig
# Copyright (c) 2023 The ZMK Contributors
# SPDX-License-Identifier: MIT

if SHIELD_KY89_LEFT

config ZMK_SPLIT_ROLE_CENTRAL
    default y

if ZMK_SPLIT_ROLE_CENTRAL

config ZMK_KEYBOARD_NAME
    default "Ky89"

endif

endif

if SHIELD_KY89_LEFT || SHIELD_KY89_RIGHT

config ZMK_SPLIT
    default y

choice BT_CTLR_TX_PWR
    default BT_CTLR_TX_PWR_PLUS_8
endchoice

config ZMK_RGB_UNDERGLOW
    select WS2812_STRIP
    select SPI
endif

if SHIELD_KY89_LEFT 

if ZMK_DISPLAY

config SSD1306
    default y

config I2C
    default y

#choice ZMK_DISPLAY_WORK_QUEUE
#    default ZMK_DISPLAY_WORK_QUEUE_DEDICATED
#endchoice


if LVGL

config LV_Z_VDB_SIZE
    default 64

config LV_DPI_DEF
    default 148

config LV_Z_BITS_PER_PIXEL
    default 1

choice LV_COLOR_DEPTH
    default LV_COLOR_DEPTH_1
endchoice

endif # LVGL

endif # ZMK_DISPLAY

endif
```
