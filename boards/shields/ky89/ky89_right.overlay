/*
 * Copyright (c) 2023 The ZMK Contributors
 *
 * SPDX-License-Identifier: MIT
 */

#include "ky89.dtsi"

/ {
    chosen {
        zmk,kscan = &kscan;
    };

    kscan: kscan {
        compatible = "zmk,kscan-gpio-matrix";
        wakeup-source;

        diode-direction = "col2row";

        row-gpios
            = <&gpio0 17 (GPIO_PULL_DOWN | GPIO_ACTIVE_HIGH)>
            , <&gpio1 13 (GPIO_PULL_DOWN | GPIO_ACTIVE_HIGH)>
            , <&gpio1 15 (GPIO_PULL_DOWN | GPIO_ACTIVE_HIGH)>
            , <&gpio0  2 (GPIO_PULL_DOWN | GPIO_ACTIVE_HIGH)>
            , <&gpio0 29 (GPIO_PULL_DOWN | GPIO_ACTIVE_HIGH)>
            , <&gpio1  6 (GPIO_PULL_DOWN | GPIO_ACTIVE_HIGH)>
            ;

        col-gpios
            = <&gpio0 20 GPIO_ACTIVE_HIGH>
            , <&gpio0 22 GPIO_ACTIVE_HIGH>
            , <&gpio0 24 GPIO_ACTIVE_HIGH>
            , <&gpio1  0 GPIO_ACTIVE_HIGH>
            , <&gpio0 11 GPIO_ACTIVE_HIGH>
            , <&gpio1  4 GPIO_ACTIVE_HIGH>
            , <&gpio0  9 GPIO_ACTIVE_HIGH>
            , <&gpio0 31 GPIO_ACTIVE_HIGH>
            , <&gpio1 11 GPIO_ACTIVE_HIGH>
            ;
    };
};

&default_transform {
    col-offset = <8>;
};

