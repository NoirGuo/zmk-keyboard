## boards/shields/cygtyl/Kconfig.defconfig
```kconfig
if SHIELD_CYGTYL_DONGLE

config ZMK_SPLIT_ROLE_CENTRAL
    default y

if ZMK_DISPLAY

config I2C
    default y

if LVGL

config LV_Z_VDB_SIZE
    default 64

config LV_DPI_DEF
    default 148

config LV_Z_BITS_PER_PIXEL
    default 1

choice LV_COLOR_DEPTH
    default LV_COLOR_DEPTH_1
endchoice

endif # LVGL

endif # ZMK_DISPLAY

endif

if SHIELD_CYGTYL_DONGLE || SHIELD_CYGTYL_PH_LEFT || SHIELD_CYGTYL_RIGHT

config ZMK_SPLIT
    default y

config ZMK_RGB_UNDERGLOW
    select WS2812_STRIP
    select SPI

endif
```

## boards/shields/cygtyl/Kconfig.shield
```kconfig
# Copyright (c) 2025 Noir Guo
# SPDX-License-Identifier: MIT

config SHIELD_CYGTYL_DONGLE
    def_bool $(shields_list_contains,cygtyl_dongle)

config SHIELD_CYGTYL_PH_LEFT
    def_bool $(shields_list_contains,cygtyl_ph_left)

config SHIELD_CYGTYL_RIGHT
    def_bool $(shields_list_contains,cygtyl_right)
```

## boards/shields/kawvin_pad24_righthand/Kconfig.defconfig
```kconfig
# Copyright (c) 2021 The ZMK Contributors
# SPDX-License-Identifier: MIT

if SHIELD_KAWVIN_PAD24_RIGHTHAND

config ZMK_KEYBOARD_NAME
    default "Kawvin_Pad24"

if ZMK_RGB_UNDERGLOW

config WS2812_STRIP
    default y
endif

endif
```

## boards/shields/ky89/Kconfig.shield
```kconfig
config SHIELD_KY89_DONGLE
    def_bool $(shields_list_contains,ky89_dongle)

config SHIELD_KY89_PERIPHERAL_LEFT
    def_bool $(shields_list_contains,ky89_peripheral_left)

config SHIELD_KY89_RIGHT
    def_bool $(shields_list_contains,ky89_right)
```

## boards/shields/noir/Kconfig.defconfig
```kconfig
if SHIELD_noir_LEFT

config ZMK_KEYBOARD_NAME
    default "noir"

config ZMK_SPLIT_ROLE_CENTRAL
    default y

endif

if SHIELD_noir_LEFT || SHIELD_noir_RIGHT

config ZMK_SPLIT
    default y

endif
```

## boards/shields/noir/Kconfig.shield
```kconfig
# Copyright (c) 2020 Noir Guo
# SPDX-License-Identifier: MIT

config SHIELD_noir_LEFT
    def_bool $(shields_list_contains,noir_left)

config SHIELD_noir_RIGHT
    def_bool $(shields_list_contains,noir_right)
```

## boards/shields/square68/Kconfig.defconfig
```kconfig
if SHIELD_SQUARE68_LEFT

config ZMK_KEYBOARD_NAME
    default "Square68"

config ZMK_SPLIT_ROLE_CENTRAL
    default y

endif

if SHIELD_SQUARE68_LEFT || SHIELD_SQUARE68_RIGHT

config ZMK_SPLIT
    default y

config ZMK_RGB_UNDERGLOW
    select WS2812_STRIP
    select SPI

if ZMK_DISPLAY

config I2C
    default y

config SSD1306
    default y

endif # ZMK_DISPLAY

if LVGL

config LV_Z_VDB_SIZE
    default 64

config LV_DPI_DEF
    default 148

config LV_Z_BITS_PER_PIXEL
    default 1

choice LV_COLOR_DEPTH
    default LV_COLOR_DEPTH_1
endchoice

endif # LVGL

endif
```

## boards/shields/square68/Kconfig.shield
```kconfig
# Copyright (c) 2020 Noir Guo
# SPDX-License-Identifier: MIT

config SHIELD_SQUARE68_LEFT
    def_bool $(shields_list_contains,square68_left)

config SHIELD_SQUARE68_RIGHT
    def_bool $(shields_list_contains,square68_right)
```

## boards/shields/velvet/Kconfig.defconfig
```kconfig
# Copyright (c) 2020 The ZMK Contributors
# SPDX-License-Identifier: MIT

if SHIELD_VELVET_DONGLE

config ZMK_SPLIT_ROLE_CENTRAL
    default y

if ZMK_DISPLAY

config SSD1306
    default y

config I2C
    default y

if LVGL

config LV_Z_VDB_SIZE
    default 64

config LV_DPI_DEF
    default 148

config LV_Z_BITS_PER_PIXEL
    default 1

choice LV_COLOR_DEPTH
    default LV_COLOR_DEPTH_1
endchoice

endif # LVGL

endif # ZMK_DISPLAY

endif

if SHIELD_VELVET_DONGLE || SHIELD_VELVET_PH_LEFT || SHIELD_VELVET_PH_RIGHT

config ZMK_SPLIT
    default y

config ZMK_RGB_UNDERGLOW
    select WS2812_STRIP
    select SPI
    
endif
```

## config/boards/shields/noir88rgb/Kconfig.defconfig
```kconfig
if SHIELD_noir88rgb_LEFT

config ZMK_KEYBOARD_NAME
    default "noir88rgb"

config ZMK_SPLIT_ROLE_CENTRAL
    default y

endif

if SHIELD_noir88rgb_LEFT || SHIELD_noir88rgb_RIGHT

config ZMK_SPLIT
    default y

if ZMK_RGB_UNDERGLOW

config WS2812_STRIP
    default y
endif

endif
```

## config/boards/shields/noir88rgb/Kconfig.shield
```kconfig
# Copyright (c) 2020 Noir Guo
# SPDX-License-Identifier: MIT

config SHIELD_noir88rgb_LEFT
    def_bool $(shields_list_contains,noir88rgb_left)

config SHIELD_noir88rgb_RIGHT
    def_bool $(shields_list_contains,noir88rgb_right)
```

## config/boards/shields/velvet/Kconfig.shield
```kconfig
# Copyright (c) 2020 The ZMK Contributors
# SPDX-License-Identifier: MIT

config SHIELD_VELVET_DONGLE
    def_bool $(shields_list_contains,velvet_dongle)

config SHIELD_VELVET_PH_LEFT
    def_bool $(shields_list_contains,velvet_ph_left)    

config SHIELD_VELVET_RIGHT
    def_bool $(shields_list_contains,velvet_right)
```

## config/west.yml
```yaml
manifest:
  remotes:
    - name: zmkfirmware
      url-base: https://github.com/zmkfirmware
    - name: sh1106
      url-base: https://github.com/NoirGuo
    - name: englmaxi
      url-base: https://github.com/englmaxi
  projects:
    - name: zmk
      remote: zmkfirmware
      revision: main
      import: app/west.yml
    - name: sh1106_oled
      remote: sh1106
      revision: main 
       
    - name: zmk-dongle-display
      remote: englmaxi
      revision: main
  self:
    path: config
```

## modules/sh1106_oled/Kconfig
```kconfig
config SH1106
    bool "SH1106 OLED Display"
    default y
    depends on I2C
    select DISPLAY
    help
      Enable driver for SH1106 OLED display controller.
```

## modules/sh1106_oled/dts/bindings/display/sh1106.yaml
```yaml
description: SH1106 OLED display controller

compatible: "sinowealth,sh1106"

include: i2c-device.yaml

properties:
  width:
    type: int
    required: true
    description: Display width in pixels

  height:
    type: int
    required: true
    description: Display height in pixels

  segment-offset:
    type: int
    required: false
    description: Column offset (SH1106 specific)

  page-offset:
    type: int
    required: false
    description: Page offset

  display-offset:
    type: int
    required: false
    description: Display offset

  multiplex-ratio:
    type: int
    required: false
    description: Multiplex ratio

  segment-remap:
    type: boolean
    required: false
    description: Segment remap (horizontal flip)

  com-invdir:
    type: boolean
    required: false
    description: COM direction (vertical flip)

  reset-gpios:
    type: phandle-array
    required: false
    description: Reset GPIO specifier
```
